/*
 * rpeak.c - streaming fixed-point R-peak detection.
 * See rpeak.h for why the causal port differs from the Python reference.
 */

#include "rpeak.h"
#include <string.h>

#define QC 30   /* biquad coefficient fractional bits */

/* butter(2, [5,15]/(360/2), 'band') as 2 cascaded biquads, coefficients in Q30.
 * Generated by scipy; max coefficient quantization error 4.7e-10. */
static const int64_t BQ_B0[2] = {      7264307LL,  1073741824LL };
static const int64_t BQ_B1[2] = {     14528614LL, -2147483648LL };
static const int64_t BQ_B2[2] = {      7264307LL,  1073741824LL };
static const int64_t BQ_A1[2] = {  -1924074302LL, -2060910655LL };
static const int64_t BQ_A2[2] = {    903255307LL,   997231969LL };

void rpeak_init(rpeak_state_t *st) {
    memset(st, 0, sizeof(*st));
    st->learning = 1;
}

/* One cascaded-biquad step, direct form II transposed. */
static int32_t bandpass(rpeak_state_t *st, int32_t x) {
    for (int k = 0; k < 2; k++) {
        int64_t acc = BQ_B0[k] * (int64_t)x + st->s1[k];
        int64_t y = acc >> QC;
        st->s1[k] = BQ_B1[k] * (int64_t)x - BQ_A1[k] * y + st->s2[k];
        st->s2[k] = BQ_B2[k] * (int64_t)x - BQ_A2[k] * y;
        x = (int32_t)y;
    }
    return x;
}

int rpeak_push(rpeak_state_t *st, int16_t sample, uint32_t *peak_index) {
    uint32_t idx = st->n;
    st->raw[idx % RPEAK_RAW_HIST] = sample;
    st->n++;

    /* 1. causal bandpass 5-15 Hz */
    int32_t bp = bandpass(st, sample);

    /* 2. five-point derivative (-1,-2,0,2,1)/8, applied causally */
    for (int i = 4; i > 0; i--) st->deriv_hist[i] = st->deriv_hist[i - 1];
    st->deriv_hist[0] = bp;
    if (st->deriv_n < 5) { st->deriv_n++; return 0; }
    int32_t d = (-st->deriv_hist[0] - 2 * st->deriv_hist[1]
                 + 2 * st->deriv_hist[3] + st->deriv_hist[4]) >> 3;

    /* 3. square */
    int64_t sq = (int64_t)d * d;

    /* 4. moving-window integration (running sum, so it is O(1) per sample) */
    st->mwi_sum -= st->mwi_buf[st->mwi_pos];
    st->mwi_buf[st->mwi_pos] = sq;
    st->mwi_sum += sq;
    st->mwi_pos = (st->mwi_pos + 1) % RPEAK_MWI_WIN;
    int64_t integrated = st->mwi_sum / RPEAK_MWI_WIN;

    /* 5. threshold learning over the first 2 s, mirroring the Python's
     *    0.3 * max(integrated[:2*fs]) */
    if (st->learning) {
        if (integrated > st->learn_max) st->learn_max = integrated;
        if (st->n >= RPEAK_LEARN_SAMPLES) {
            st->threshold = (st->learn_max * 3) / 10;
            st->learning = 0;
        }
        st->prev_prev_int = st->prev_int;
        st->prev_int = integrated;
        return 0;
    }

    /* 6. local maximum of the integrated signal, above threshold.
     *    The candidate is the PREVIOUS sample, since we now have both
     *    neighbours (this is the streaming form of the Python's
     *    x[i-1] < x[i] >= x[i+1] test). */
    int found = 0;
    int64_t cand = st->prev_int;
    uint32_t cand_idx = idx - 1;

    if (cand > st->threshold && cand > st->prev_prev_int && cand >= integrated) {
        /* Compare like with like. cand_idx lives in the DETECTION domain,
         * st->last_peak in the REFINED domain ~RPEAK_GROUP_DELAY samples
         * earlier. Comparing them directly inflates every gap by the group
         * delay, so this cheap pre-gate converts first. The authoritative
         * check is on the refined index, after refinement below. */
        int64_t cand_ref = (int64_t)cand_idx - RPEAK_GROUP_DELAY;
        if (!st->have_peak ||
            (cand_ref - (int64_t)st->last_peak) >= RPEAK_REFRACTORY) {
            /* 7. refine on the RAW signal.
             *
             * Centre the search at cand_idx - RPEAK_GROUP_DELAY, NOT at
             * cand_idx: the causal filter chain lags the true QRS by that much.
             * Searching around the uncompensated index would systematically
             * report peaks ~120 ms late. */
            int64_t centre = (int64_t)cand_idx - RPEAK_GROUP_DELAY;
            int64_t lo = centre - RPEAK_REFINE_WIN;
            int64_t hi = centre + RPEAK_REFINE_WIN;
            if (lo < 0) lo = 0;
            if (hi > (int64_t)idx) hi = idx;
            /* stay inside what the circular history still holds */
            if ((int64_t)st->n - lo > RPEAK_RAW_HIST)
                lo = (int64_t)st->n - RPEAK_RAW_HIST;

            if (hi >= lo) {
                uint32_t best = (uint32_t)lo;
                int16_t bestv = st->raw[(size_t)lo % RPEAK_RAW_HIST];
                for (int64_t p = lo + 1; p <= hi; p++) {
                    int16_t v = st->raw[(size_t)p % RPEAK_RAW_HIST];
                    if (v > bestv) { bestv = v; best = (uint32_t)p; }
                }
                /* Authoritative refractory gate, in the refined domain.
                 * `best != last_peak` was not enough: refinement windows of
                 * two consecutive candidates overlap the same QRS, so it let
                 * through "beats" 1-7 samples apart. A heart cannot beat
                 * twice in 20 ms. */
                if (!st->have_peak ||
                    ((int64_t)best - (int64_t)st->last_peak) >= RPEAK_REFRACTORY) {
                    st->last_peak = best;
                    st->have_peak = 1;
                    if (peak_index) *peak_index = best;
                    found = 1;
                }
            }
            /* adaptive threshold, as in the Python reference */
            st->threshold = (st->threshold * 7) / 8 + cand / 16;
        }
    }

    st->prev_prev_int = st->prev_int;
    st->prev_int = integrated;
    return found;
}

size_t rpeak_detect(const int16_t *sig, size_t n,
                    uint32_t *out_idx, size_t max_out) {
    rpeak_state_t st;
    rpeak_init(&st);
    size_t count = 0;
    for (size_t i = 0; i < n; i++) {
        uint32_t p;
        if (rpeak_push(&st, sig[i], &p) && count < max_out)
            out_idx[count++] = p;
    }
    return count;
}

int rpeak_extract_beat(const int16_t *sig, size_t n, uint32_t peak,
                       int16_t out[256]) {
    const int PRE = RPEAK_BEAT_PRE, POST = RPEAK_BEAT_POST;
    if ((int64_t)peak - PRE < 0) return -1;
    if ((size_t)peak + POST > n) return -1;

    const int16_t *w = sig + (peak - PRE);
    int16_t mn = w[0], mx = w[0];
    for (int i = 1; i < 256; i++) {
        if (w[i] < mn) mn = w[i];
        if (w[i] > mx) mx = w[i];
    }
    int32_t range = (int32_t)mx - mn;
    if (range == 0) {                     /* flat window: mirror normalize_beat */
        for (int i = 0; i < 256; i++) out[i] = w[i];
        return 0;
    }
    /* out = (2*(x-mn)/range - 1) in Q8.8, i.e. scaled to [-256, 256] */
    for (int i = 0; i < 256; i++) {
        int64_t num = 2LL * 256 * ((int32_t)w[i] - mn);
        int64_t v = (num + range / 2) / range - 256;
        if (v > 32767) v = 32767;
        if (v < -32768) v = -32768;
        out[i] = (int16_t)v;
    }
    return 0;
}

/* ---------------------------------------------------------------------------
 * Context-filtered beat extraction. See rpeak.h for why this exists.
 *
 * butter(4, [0.5, 40]/(360/2), 'band') as 4 cascaded biquads, Q30.
 * ------------------------------------------------------------------------- */
static const int64_t BP_B0[4] = { 7091931LL, 1073741824LL, 1073741824LL, 1073741824LL };
static const int64_t BP_B1[4] = { 14183863LL, 2147483648LL, -2147483648LL, -2147483648LL };
static const int64_t BP_B2[4] = { 7091931LL, 1073741824LL, 1073741824LL, 1073741824LL };
static const int64_t BP_A1[4] = { -1051138559LL, -1328730922LL, -2129931914LL, -2140376103LL };
static const int64_t BP_A2[4] = { 283479280LL, 657644125LL, 1056274629LL, 1066716334LL };

/* 4 KB of static scratch. Deliberately not on the stack. */
static int32_t ctx_buf[RPEAK_CTX_LEN];

/* One forward pass of the whole cascade, in place. Samples stay in the same
 * scaled domain throughout: acc is Q(30+SHIFT), so acc>>30 is Q(SHIFT). */
static void bp_forward(int32_t *x, int n) {
    for (int k = 0; k < 4; k++) {
        int64_t s1 = 0, s2 = 0;
        for (int i = 0; i < n; i++) {
            int64_t xn  = x[i];
            int64_t acc = BP_B0[k] * xn + s1;
            int64_t yn  = acc >> QC;
            s1 = BP_B1[k] * xn - BP_A1[k] * yn + s2;
            s2 = BP_B2[k] * xn - BP_A2[k] * yn;
            x[i] = (int32_t)yn;
        }
    }
}

static void reverse_i32(int32_t *x, int n) {
    for (int i = 0, j = n - 1; i < j; i++, j--) {
        int32_t t = x[i]; x[i] = x[j]; x[j] = t;
    }
}

int rpeak_extract_beat_ctx(const int16_t *sig, size_t n, uint32_t peak,
                           int16_t out[256]) {
    const int PRE = RPEAK_BEAT_PRE, HALF = RPEAK_CTX_LEN / 2;
    /* RPEAK_BEAT_POST isn't needed here: the 256-sample beat width below is
     * implicit in the fixed loop bound, and PRE + POST == 256 is exactly
     * what makes that hold - see RPEAK_BEAT_PRE/POST's comment in rpeak.h. */

    int64_t lo = (int64_t)peak - HALF;
    int64_t hi = lo + RPEAK_CTX_LEN;
    if (lo < 0 || hi > (int64_t)n) return -1;   /* not enough context */

    /* load, scaled up so the cascade keeps fractional resolution */
    for (int i = 0; i < RPEAK_CTX_LEN; i++)
        ctx_buf[i] = (int32_t)sig[lo + i] << RPEAK_FILT_SHIFT;

    /* zero-phase = forward, then backward over the reversed signal */
    bp_forward(ctx_buf, RPEAK_CTX_LEN);
    reverse_i32(ctx_buf, RPEAK_CTX_LEN);
    bp_forward(ctx_buf, RPEAK_CTX_LEN);
    reverse_i32(ctx_buf, RPEAK_CTX_LEN);

    /* the beat sits in the middle, far from the unpadded edges */
    const int32_t *w = ctx_buf + (HALF - PRE);
    int32_t mn = w[0], mx = w[0];
    for (int i = 1; i < 256; i++) {
        if (w[i] < mn) mn = w[i];
        if (w[i] > mx) mx = w[i];
    }
    int64_t range = (int64_t)mx - mn;
    if (range == 0) {
        for (int i = 0; i < 256; i++) out[i] = 0;
        return 0;
    }
    for (int i = 0; i < 256; i++) {
        int64_t num = 2LL * 256 * ((int64_t)w[i] - mn);
        int64_t v   = (num + range / 2) / range - 256;
        if (v >  32767) v =  32767;
        if (v < -32768) v = -32768;
        out[i] = (int16_t)v;
    }
    return 0;
}

/* ---------------------------------------------------------------------------
 * QRS width - slope-threshold boundary search.
 *
 * WHY THIS APPROACH
 * The R-wave upstroke/downstroke is by far the steepest part of a beat -
 * that is exactly what the derivative+MWI stage above exploits to FIND the
 * peak in the first place. The same idea, run outward from a peak we
 * already know, finds where the QRS complex ENDS: walk away from the R peak
 * and the slope collapses once you leave the QRS and enter the
 * (comparatively flat) ST segment or isoelectric baseline before Q.
 *
 * This needs no new signal path and no floating point - it runs on the same
 * 256-sample window already cut and normalized for the CNN (see
 * rpeak_extract_beat_ctx() above), so it is free to compute alongside
 * classification: no extra buffering, no extra filtering pass.
 *
 * ALGORITHM
 *   1. Take the first difference of the beat over a search window centred
 *      on the R peak (+-QRS_SEARCH samples each side - at 360 Hz that is
 *      ~139 ms, generous enough for a wide, pathological QRS; normal QRS
 *      is 80-120 ms so this always has margin).
 *   2. Find the steepest slope in that window - this is the R-wave edge,
 *      and it scales the threshold so the method works whether the beat's
 *      min-max normalization happened to stretch it tall or squash it flat.
 *   3. threshold = steepest / QRS_THRESH_DIV. Starting at the R peak, walk
 *      outward in each direction. The boundary is the first sample, AFTER
 *      the slope has already been above threshold at least once, where
 *      QRS_FLAT consecutive samples all fall back below threshold - a
 *      single quiet sample from notching or quantization noise does not
 *      end the search early.
 *   4. Width = offset_index - onset_index.
 *
 * A beat where no boundary is found (essentially flat signal, or noise
 * that never dips below threshold) returns -1 rather than a fabricated
 * number - see rpeak_qrs_width_samples().
 * ------------------------------------------------------------------------- */
#define QRS_SEARCH     50   /* samples each side of R to search, ~139 ms */
#define QRS_THRESH_DIV 8    /* boundary slope = steepest slope / this */
#define QRS_FLAT       3    /* consecutive below-threshold samples to confirm a boundary */

/* Walk from the R peak toward one edge of the window (step = -1 for the Q
 * side / onset, +1 for the J-point side / offset). Returns the boundary
 * sample index, or -1 if the walk exits the search range without ever
 * confirming QRS_FLAT consecutive quiet samples after a steep run. */
static int qrs_boundary(const int16_t *beat, int r, int step, int thresh) {
    int seen_high = 0, flat_run = 0;
    int limit = r + step * QRS_SEARCH;
    if (limit < 1)   limit = 1;      /* beat[i+step] must stay in [0,255] */
    if (limit > 254) limit = 254;

    for (int i = r; i != limit; i += step) {
        int d = (int)beat[i + step] - (int)beat[i];
        if (d < 0) d = -d;
        if (d >= thresh) {
            seen_high = 1;
            flat_run = 0;
        } else if (seen_high) {
            if (++flat_run >= QRS_FLAT)
                return i - (QRS_FLAT - 1) * step;   /* back to where flatness began */
        }
    }
    return -1;
}

int rpeak_qrs_width_samples(const int16_t beat[256], int r_index) {
    int lo = r_index - QRS_SEARCH; if (lo < 1)   lo = 1;
    int hi = r_index + QRS_SEARCH; if (hi > 254) hi = 254;
    if (lo >= hi) return -1;         /* r_index too close to a buffer edge */

    int peak_slope = 0;
    for (int i = lo; i < hi; i++) {
        int d = (int)beat[i + 1] - (int)beat[i];
        if (d < 0) d = -d;
        if (d > peak_slope) peak_slope = d;
    }
    if (peak_slope == 0) return -1;             /* flat beat, nothing to find */

    int thresh = peak_slope / QRS_THRESH_DIV;
    if (thresh < 1) thresh = 1;

    int onset  = qrs_boundary(beat, r_index, -1, thresh);
    int offset = qrs_boundary(beat, r_index, +1, thresh);
    if (onset < 0 || offset < 0 || offset <= onset) return -1;

    return offset - onset;
}

int rpeak_qrs_width_ms(const int16_t beat[256], int r_index) {
    int w = rpeak_qrs_width_samples(beat, r_index);
    if (w < 0) return -1;
    return (w * 1000 + RPEAK_FS / 2) / RPEAK_FS;
}

/* ---------------------------------------------------------------------------
 * P-wave width - EXPERIMENTAL, meaningfully less reliable than QRS width
 * above. See rpeak.h for the full caveat; short version: much smaller
 * amplitude + gentler slope than a QRS complex means this is far more likely
 * to miss a real P-wave or mistake noise for one, and unlike QRS width it
 * has never been validated against a labeled dataset - the numeric result
 * is a best-effort estimate, not something to build a real conclusion on.
 *
 * METHOD:
 *   1. Re-find QRS onset (same slope-threshold walk as QRS width) - the
 *      P-wave must end at or before this point.
 *   2. Search [qrs_onset - P_SEARCH_MAX, qrs_onset - P_SEARCH_MIN_GAP]
 *      (clipped to the buffer) for the sample with the largest deviation
 *      from zero. `beat[]` arrives already min-max normalized by
 *      rpeak_extract_beat_ctx(), so a real P-wave should stand out from a
 *      near-zero isoelectric baseline IF one is present and not buried in
 *      noise.
 *   3. If that peak's magnitude doesn't clear P_MIN_AMPLITUDE, there's
 *      nothing confidently a P-wave here - return -1 rather than measure
 *      noise and report a number for it.
 *   4. Walk outward from that candidate peak until the signal drops below a
 *      FRACTION of the peak's own height (not a slope threshold - tried
 *      that first, adapted from the QRS approach below, and it doesn't
 *      work: a P-wave's slope is so gentle it's barely above the sample-to-
 *      sample quantization step, so a slope threshold never sees a stable
 *      "flat" run and just walks to the edge of its search range. An
 *      amplitude-fraction boundary is the right tool for a smooth bump
 *      rather than a sharp spike - confirmed against a synthetic P-wave
 *      test before trusting this). The offset side is capped at qrs_onset
 *      so it can never claim part of the QRS complex as P-wave.
 * ------------------------------------------------------------------------- */
#define P_SEARCH_MAX      79   /* samples before QRS onset to look, ~220 ms -
                                 * covers a typical PR interval */
#define P_SEARCH_MIN_GAP  8    /* samples of PR-segment gap left between the
                                 * P search zone and QRS onset, ~22 ms */
#define P_MIN_AMPLITUDE   15   /* Q8.8 units (beat[] normalized to roughly
                                 * +-256) - below this, call it noise, not a
                                 * P-wave. Unvalidated starting guess - retune
                                 * against real captured beats if this proves
                                 * too trigger-happy or too blind. */
#define P_BOUNDARY_FRAC_PCT 25 /* onset/offset = first point walking outward
                                 * from the peak where |value| falls below
                                 * this percent of the peak's own magnitude -
                                 * a standard "fraction of peak height" way
                                 * to bound a smooth bump; unvalidated, tune
                                 * against real captured beats if the widths
                                 * this produces look consistently too wide
                                 * or too narrow */

/* Walk from p_center toward one edge (step = -1 onset / +1 offset) until
 * |beat[i]| first drops below frac_pct% of peak_mag. limit bounds how far
 * the walk is allowed to go (exclusive) - the caller passes the P search
 * zone edge on the onset side and qrs_onset on the offset side, so this
 * can never wander into the QRS complex or off the buffer. Returns the
 * boundary index, or -1 if the walk reaches limit without ever dropping
 * below the fraction (a P-wave that never returns to baseline within its
 * own search zone isn't one this function can measure confidently). */
static int p_wave_boundary(const int16_t *beat, int p_center, int step,
                            int peak_mag, int limit) {
    int floor_mag = (peak_mag * P_BOUNDARY_FRAC_PCT) / 100;
    for (int i = p_center; i != limit; i += step) {
        int mag = beat[i] < 0 ? -beat[i] : beat[i];
        if (mag < floor_mag) return i;
    }
    return -1;
}

/* Steps 1-2 shared between rpeak_p_wave_width_samples() and the
 * rpeak_p_wave_peak_mag() diagnostic below: re-find QRS onset, then locate
 * the largest-deviation-from-zero sample in the search zone before it.
 * Returns the candidate P-wave center index (or -1 if there was nowhere
 * even to look - QRS onset itself couldn't be found, or no room left in
 * the buffer), and always writes *out_peak_mag (0 if returning -1) so a
 * caller that only wants the magnitude doesn't have to care why a real
 * center wasn't found. *out_qrs_onset and *out_search_lo are only
 * meaningful when the return value is >= 0. */
static int p_wave_find_candidate(const int16_t *beat, int r_index,
                                  int *out_peak_mag, int *out_qrs_onset,
                                  int *out_search_lo) {
    *out_peak_mag = 0;

    /* Step 1: re-find QRS onset, same method as rpeak_qrs_width_samples(). */
    int qlo = r_index - QRS_SEARCH; if (qlo < 1)   qlo = 1;
    int qhi = r_index + QRS_SEARCH; if (qhi > 254) qhi = 254;
    if (qlo >= qhi) return -1;

    int qrs_peak_slope = 0;
    for (int i = qlo; i < qhi; i++) {
        int d = (int)beat[i + 1] - (int)beat[i];
        if (d < 0) d = -d;
        if (d > qrs_peak_slope) qrs_peak_slope = d;
    }
    if (qrs_peak_slope == 0) return -1;
    int qrs_thresh = qrs_peak_slope / QRS_THRESH_DIV;
    if (qrs_thresh < 1) qrs_thresh = 1;
    int qrs_onset = qrs_boundary(beat, r_index, -1, qrs_thresh);
    if (qrs_onset < 0) return -1;   /* nothing to anchor the P search on */

    /* Step 2: search zone before QRS onset for the P-wave candidate peak. */
    int search_hi = qrs_onset - P_SEARCH_MIN_GAP;
    int search_lo = qrs_onset - P_SEARCH_MAX;
    if (search_lo < 1) search_lo = 1;
    if (search_hi > 254) search_hi = 254;
    if (search_lo >= search_hi) return -1;   /* no room left to search */

    int p_center = -1;
    int p_peak_mag = 0;
    for (int i = search_lo; i <= search_hi; i++) {
        int mag = beat[i] < 0 ? -beat[i] : beat[i];
        if (mag > p_peak_mag) { p_peak_mag = mag; p_center = i; }
    }
    if (p_center < 0) return -1;

    *out_peak_mag = p_peak_mag;
    *out_qrs_onset = qrs_onset;
    *out_search_lo = search_lo;
    return p_center;
}

/* Diagnostic: the raw peak magnitude p_wave_find_candidate() found in the
 * search zone, WITHOUT the P_MIN_AMPLITUDE gate rpeak_p_wave_width_*()
 * applies - lets you see how close a rejected beat came (e.g. "was it 14,
 * just under the 15 gate, or was it 2, nothing there at all") instead of
 * only ever seeing pass/fail. Not meant to be trusted as a real
 * measurement on its own, same caveats as the width functions above -
 * this is purely for tuning P_MIN_AMPLITUDE against real captured data.
 * Returns the magnitude (Q8.8 units, always >= 0), or -1 if there wasn't
 * even room to search (see p_wave_find_candidate()). */
int rpeak_p_wave_peak_mag(const int16_t beat[256], int r_index) {
    int peak_mag, qrs_onset, search_lo;
    int center = p_wave_find_candidate(beat, r_index, &peak_mag, &qrs_onset, &search_lo);
    return (center < 0) ? -1 : peak_mag;
}

int rpeak_p_wave_width_samples(const int16_t beat[256], int r_index) {
    int p_peak_mag, qrs_onset, search_lo;
    int p_center = p_wave_find_candidate(beat, r_index, &p_peak_mag, &qrs_onset, &search_lo);
    if (p_center < 0) return -1;

    /* Step 3: amplitude gate - a real P-wave should clear the noise floor. */
    if (p_peak_mag < P_MIN_AMPLITUDE) return -1;

    /* Step 4: amplitude-fraction boundary walk (see p_wave_boundary() and
     * the header comment above for why this replaced a slope-threshold
     * walk). onset_limit is one past search_lo (walk must stay inside the
     * zone that was actually searched for a peak); offset_limit is
     * qrs_onset itself, so the offset side can never cross into the QRS
     * complex even if the P-wave's trailing edge is slow to decay. */
    int onset_limit = search_lo - 1; if (onset_limit < 0) onset_limit = 0;
    int p_onset  = p_wave_boundary(beat, p_center, -1, p_peak_mag, onset_limit);
    int p_offset = p_wave_boundary(beat, p_center, +1, p_peak_mag, qrs_onset);
    if (p_onset < 0 || p_offset < 0) return -1;
    if (p_offset <= p_onset) return -1;

    return p_offset - p_onset;
}

int rpeak_p_wave_width_ms(const int16_t beat[256], int r_index) {
    int w = rpeak_p_wave_width_samples(beat, r_index);
    if (w < 0) return -1;
    return (w * 1000 + RPEAK_FS / 2) / RPEAK_FS;
}
